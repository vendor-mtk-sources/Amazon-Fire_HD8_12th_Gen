## src/kernel/mediatek/mt8169/5.4/drivers/tee/optee/Kconfig
```kconfig
# SPDX-License-Identifier: GPL-2.0-only
# OP-TEE Trusted Execution Environment Configuration
config OPTEE
	tristate "OP-TEE"
	depends on HAVE_ARM_SMCCC
	depends on MMU
	help
	  This implements the OP-TEE Trusted Execution Environment (TEE)
	  driver.

config OPTEE_SHM_NUM_PRIV_PAGES
	int "Private Shared Memory Pages"
	default 1
	depends on OPTEE
	help
	  This sets the number of private shared memory pages to be
	  used by OP-TEE TEE driver.

config OPTEE_NEW_RPC_COMMAND_ID_SET
	bool "OP-TEE support new MTK RPC Command ID Set"
	default n
	depends on OPTEE
	help
	  This use new mtk rpc command id set from OP-TEE RPC.

config OPTEE_REE_CONSOLE
	tristate "OP-TEE REE Console"
	default y
	depends on OPTEE
	help
	  This implements the mechanism to accept log from OP-TEE RPC.

config OPTEE_REE_CLK_CTRL
	tristate "OP-TEE REE Clock Control"
	default y
	depends on OPTEE && OF
	help
	  This implements the mechanism to control clock by request from
	  OP-TEE RPC.
```

## src/kernel/mediatek/mt8169/5.4/drivers/thermal/mediatek/Kconfig
```kconfig
config MTK_THERMAL
	tristate "Temperature sensor driver for mediatek SoCs"
	depends on ARCH_MEDIATEK || COMPILE_TEST
	depends on HAS_IOMEM
	depends on NVMEM || NVMEM=n
	depends on RESET_CONTROLLER
	default y
	help
	  Enable this option if you want to have support for thermal management
	  controller present in Mediatek SoCs

config MTK_SOC_THERMAL_LVTS
        tristate "LVTS (Low voltage thermal sensor) driver for Mediatek SoCs"
        depends on HAS_IOMEM
        depends on NVMEM
        depends on RESET_TI_SYSCON
        help
          Enable this option if you want to get SoC temperature
          information for Mediatek platforms. This driver
          configures LVTS thermal controllers to collect temperatures
          via Analog Serial Interface(ASIF).

config MTK_PMIC_THERMAL
	tristate "PMIC thermal sensor driver for Mediatek SoCs"
	depends on MT635X_EFUSE || MT6359_EFUSE
	depends on MEDIATEK_MT635X_AUXADC
	help
	  Enable this option if you want to get PMIC temperature
	  for Mediatek platforms.
	  This driver reads the voltage value from PMIC AUXADC channels,
	  and converts raw value to PMIC temperature via PMIC efuse data.

config MTK_CHARGER_THERMAL
        tristate "Mediatek charger cooling framework"
        depends on MTK_CHARGER
        help
          Enable this option to turn on charger throttle mechanisms
          for Mediatek platforms.
          This option depends on MTK_CHARGER which is
          MTK charger driver.
```

## src/kernel/mediatek/mt8169/5.4/drivers/thermal/virtual_sensor_tablet/Kconfig
```kconfig
config VIRTUAL_SENSOR_THERMAL
	tristate "VIRTUAL_SENSOR thermal management"
	help
	  Adds VIRTUAL_SENSOR thermal management implementation according to the thermal
	  management framework. A thermal zone with several trip points will be
	  created. Cooling devices can be bound to the trip points to cool this
	  thermal zone if trip points reached.

config THERMAL_SHUTDOWN_LAST_KMESG
	bool "THERMAL_SHUTDOWN_LAST_KMESG save the last kmsg"
	depends on VIRTUAL_SENSOR_THERMAL
	help
	  Save the last kmsg when thermal shuts down the system.

config THERMAL_DEBOUNCE
	bool "THERMAL_DEBOUNCE design"
	depends on VIRTUAL_SENSOR_THERMAL
	help
	  Drop the invalid temperature change value.

config THERMAL_FOD
	bool "Thermal mechanism to detect foreign object"
	depends on VIRTUAL_SENSOR_THERMAL
	help
	  Whenever wireless charging is working, it can be used to detect foreign objects
	  correctly and avoid causing the device too overheat.

config CPU_MULTIPLE_CLUSTERS
	bool "Thermal cpu separate large and little core"
	depends on VIRTUAL_SENSOR_THERMAL
	help
	  When trigger cpu frequency limiting, large and little cores use
	  different ways to limit frequency.
```
