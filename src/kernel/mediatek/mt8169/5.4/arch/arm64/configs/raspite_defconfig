## src/kernel/mediatek/mt8169/5.4/drivers/staging/amazon/Kconfig
```kconfig
menu "Amazon"

config AMAZON
	bool "Amazon Drivers"
	default N
	---help---
	  Enable support for various drivers needed on the Amazon Fire OS platform

source "drivers/staging/amazon/dspframework/Kconfig"

if AMAZON

config USER_BUILD
	bool "USER_BUILD"
	default n
	help
	  Indicate if user build

config AMAZON_SIGN_OF_LIFE
	tristate "Amazon Sign of Life"
	help
	  enable the life cycle metrics to log device boot and shutdown information

config AMAZON_POWEROFF_LOG
	bool "Long press key power off log"
	default N
	help
	  enable Long press key power off log

config AMAZON_INPUT_KEYCOMBO
	tristate "Amazon key combo"
	depends on INPUT
	select INPUT_KEYCOMBO
	help
	  Say Y here if you want to panic kernel / power off when some keys are pressed;

	  To compile this driver as a module, choose M here: the
	  module will be called amzn_keycombo.

config AMAZON_DRV_TEST
	tristate "Amazon common BSP driver test module"
	depends on AMAZON_METRICS_LOG && AMAZON_SIGN_OF_LIFE && IDME
	default n
	help
	  Enable Amazon Common BSP test module

endif #if AMAZON

endmenu
```

## src/kernel/mediatek/mt8169/5.4/drivers/staging/android/ion/Kconfig
```kconfig
# SPDX-License-Identifier: GPL-2.0
menuconfig ION
	bool "Ion Memory Manager"
	depends on HAS_DMA && MMU
	select GENERIC_ALLOCATOR
	select DMA_SHARED_BUFFER
	select MTK_ION_DEBUG
	help
	  Choose this option to enable the ION Memory Manager,
	  used by Android to efficiently allocate buffers
	  from userspace that can be shared between drivers.
	  If you're not using Android its probably safe to
	  say N here.

config MTK_ION_DEBUG
	bool "Ion heap debug information"
	depends on ION
	help
	  Choose this option to open Mediatek debug information,
	  the information could support all ION heaps. It can
	  show the buffer information about current ion heap.

source "drivers/staging/android/ion/heaps/Kconfig"
```
