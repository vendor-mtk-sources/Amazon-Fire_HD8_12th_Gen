## src/kernel/mediatek/mt8169/5.4/drivers/misc/mediatek/hifi_dsp/Kconfig
```kconfig
config MTK_HIFIXDSP_SUPPORT
	tristate "Specify Platform Support HIFIxDSP"
	help
	  HIFIxDSP is a MediaTek in-house DSP which can do
	  different audio process from IPI interface.
	  Set Y to enable this feature.
	  If unsure,
	  Set N to stay with legacy feature.

config MTK_HIFIXDSP_VERSION
	string "MediaTek HIFIXDSP Version"
	help
	  For DSP kernel driver config. This config can
	  indicate DSP version. This feature need to work
	  with MTK_HIFIXDSP_SUPPORT.
```

## src/kernel/mediatek/mt8169/5.4/drivers/misc/mediatek/hifidsp_audio_ipi/Kconfig
```kconfig
config MTK_HIFIXDSP_AUDIO_IPI
	tristate "Specify Platform Support HIFIxDSP AUDIO IPI"
	depends on MTK_HIFIXDSP_SUPPORT
	help
	  HIFIxDSP is a MediaTek in-house DSP which can do
	  different audio process from IPI interface.
	  Set Y to enable this feature.
	  If unsure,
	  Set N to stay with legacy feature.

config MTK_HIFIXDSP_AUDIO_IPI_VERSION
	string "MediaTek HIFIXDSP IPI Version"
	help
	  For Audio DSP kernel driver config. This config can
	  indicate AUDIO IPI version. This feature need to work
	  with MTK_HIFIXDSP_AUDIO_IPI.
```

## src/kernel/mediatek/mt8169/5.4/drivers/misc/mediatek/iommu/Kconfig
```kconfig
config MTK_IOMMU_MISC
	tristate "misc iommu driver for enhanced feature"
	depends on MTK_IOMMU
	help
	  Choose this option to enable mediatek misc iommu driver.
	  Misc iommu includes the enhanced features about iommu hardware.
	  For example, it can implement iommu secure driver for secure
	  feature or debug feature.

config MTK_IOMMU_MISC_SEC
	tristate "Enable Mediatek secure M4U"
	depends on MTK_IOMMU_MISC
	depends on TRUSTONIC_TEE_SUPPORT || MICROTRUST_TEE_SUPPORT || OPTEE
	help
	  Choose this option to enable mediatek secure iommu driver.
	  For SVP or secure camera feature, user only can access
	  continuous secure memory, and the number of secure memory's
	  bit no more than 32. So the secure memory need to map to mva
	  by m4u. Secure m4u driver can map non-physical continuous
	  secure memory to continuous modified virtual address.

config MTK_IOMMU_MISC_DBG
	tristate "Enable Mediatek IOMMU debug feature"
	depends on MTK_IOMMU_MISC
	help
	  Choose this option to enable mediatek iommu debug driver.
	  According to the characteristic of hardware, we need to add
	  some debug information. For example translation fault, hardware
	  dump information and so on. In addition, for ion buffer, we can
	  use dma_buf information to monitor iova, but if user use
	  "dma_alloc_attrs" to allocate buffer, we can not monitor iova.
	  So we can use list to save all iova node and dump it.
```

## src/kernel/mediatek/mt8169/5.4/drivers/misc/mediatek/ldvt/Kconfig
```kconfig
config MTK_LDVT_SAMPLE
	bool "MediaTek sampel driver for LDVT"
	depends on MTK_LDVT_SUPPORT
	default n
	help
	  This enables MediaTek sample driver for ldvt.DVT means
	  IC Design Validation Test, so LDVT is LinuxOS test
	  environment to verify HW modules, such as USB,Ethernet,
	  etc.

config MTK_LDVT_DISP
	bool "MediaTek Disp driver for LDVT"
	depends on MTK_LDVT_SUPPORT
	default n
	help
	  MediaTek sample driver for ldvt.DVT means
	  Design Validation Test, so LDVT is LinuxOS test
	  environment to verify HW modules
	  disp driver for ldvt

config MTK_LDVT_UDVT
	bool "MediaTek UDVT driver for LDVT"
	depends on MTK_LDVT_SUPPORT
	default n
	help
	  MediaTek sample driver for ldvt.DVT means
	  Design Validation Test, so LDVT is LinuxOS test
	  environment to verify HW modules
	  UDVT driver for ldvt
```

## src/kernel/mediatek/mt8169/5.4/drivers/misc/mediatek/leakage_table/Kconfig
```kconfig
config MTK_STATIC_POWER
	tristate "MediaTek GPU Voltage Scaling Module"
	help
	  This driver provides leakage efuse dump for
	  multiple domain. Those leakage (mw) are
	  calculated by Efuse value and ATE Voltage.
	  Select "y" if you want to enable this features.
	  Select "n" if unsure.

config MT8169_STATIC_POWER
	tristate "MediaTek MT8169 Voltage Scaling Module"
	help
	  This driver provides leakage efuse dump for
	  multiple domain. Those leakage (mw) are
	  calculated by Efuse value and ATE Voltage.
	  Select "y" if you want to enable this features.
	  Select "n" if unsure.
```

## src/kernel/mediatek/mt8169/5.4/drivers/misc/mediatek/mtee/Kconfig
```kconfig
config MTK_IN_HOUSE_TEE_SUPPORT
	bool "Enable MTK In House TEE Support"
	help
	  This option decides if the support MTK in-house TEE
	  (Trusted Execution Environment)
	  Set to yes if MTK TEE is supported.
	  If you are not sure if it is supported, set it to no.

config MTK_DRM_KEY_MNG_SUPPORT
	bool "Enable MTK DRM Key Manager Support"
	depends on (MTK_IN_HOUSE_TEE_SUPPORT) || (TRUSTONIC_TEE_SUPPORT) || (TRUSTY)
	help
	  This enable MTK DRM Key Manager Support.
	  depending on MTK In-House TEE Support
	  or Trustonic TEE Support

config MTEE_CMA_SECURE_MEMORY
	tristate "MTEE using CMA for secure memory allocation"
	default y
	depends on OF
	depends on CMA
	depends on (MTK_IN_HOUSE_TEE_SUPPORT) || (TEE)
	depends on (WFD_DYNAMIC_SEC_BUF)
	help
	  Enable allocation secure memory from CMA to free the memory
	  back to Linux CMA when secure memory buffer was not used.
```

## src/kernel/mediatek/mt8169/5.4/drivers/misc/mediatek/performance/Kconfig
```kconfig
config MTK_FPSGO_V3
	tristate "Support FPSGO_V3 framework"
	help
	  Support FPSGO_V3 framework for most FPS performance and
	  low power balance. As a perquisite to ensure FPS performance,
	  FPSGO_V3 persuades lowest power consumption for better DoU
	  endurance and gaming experience.
	  FPSGO_V3 include AI performance and low power.
	  If you are not sure about this, set n.

config MTK_PERFORMANCE_MODULE
	tristate "Mediatek Performance Module"
	help
	  For MediaTek performance modules, such as FPSGO and EARA-QoS
	  Select "y" if you want to enable power throttling feature
	  Select "n" if unsure.

config MTK_PERFMGR_TOUCH_BOOST
	tristate "touch boost in performance manager"
	depends on MTK_PERFORMANCE_MODULE
	help
	  MTK_PERFMGR_TOUCH_BOOST is the kernel config of touch boost
	  feature designed by MTK, which is a performance improving
	  feature for user experience. When the device receives touch
	  event, it will raise system resources(CPU frequency / CPU cores)
	  for better user experience.
```

## src/kernel/mediatek/mt8169/5.4/drivers/misc/mediatek/rt-regmap/Kconfig
```kconfig
config RT_REGMAP
	tristate "Richtek Regmap Part"
	help
	  Say Y to enable Richtek regmap
	  Interface for register debug node and ops.
	  This config decide to use regmap easy
	  for debug in RT chip.
```

## src/kernel/mediatek/mt8169/5.4/drivers/misc/mediatek/sensors-1.0/accelerometer/mc34xx/Kconfig
```kconfig
config MTK_MC34XX
	tristate "MC34xx for MediaTek package"
	help
	  It support different accelerometer sensor.
	  If this option is set,
	  it will support
	  MC34xx Accelerometer.
```

## src/kernel/mediatek/mt8169/5.4/drivers/misc/mediatek/sensors-1.0/accelerometer/sc7a20/Kconfig
```kconfig
config MTK_SC7A20
	tristate "SC7A20 for MediaTek package"
	help
	  It support different accelerometer sensor.
	  If this option is set,
	  it will support
	  SC7A20 Accelerometer.
```

## src/kernel/mediatek/mt8169/5.4/drivers/misc/mediatek/sensors-1.0/accelerometer/stk8xxx/Kconfig
```kconfig
config MTK_STK8XXX
	tristate "STK8xxx for MediaTek package"
	default n
	help
	  It support different accelerometer sensor.
	  If this option is set,
	  it will support
	  STK8xxx Accelerometer.
```

## src/kernel/mediatek/mt8169/5.4/drivers/misc/mediatek/sensors-1.0/alsps/ltr578/Kconfig
```kconfig
config MTK_LTR578
	tristate "LTR578 for MediaTek alsps package"
	default n
	help
	  Support for ROHM LTR578 ALS.

config ALS_RAW_SUPPORT
	bool "LTR578 Store Raw Lux Data"
	default n
	help
	  SUPPORT CONTROL LTR578 TO STORE RAW LUX DATA
```

## src/kernel/mediatek/mt8169/5.4/drivers/misc/mediatek/subpmic/Kconfig
```kconfig
config MFD_MT6370_PMU
	tristate "Support for MT6370 PMU part"
	depends on I2C
	select MFD_CORE
	select RT_REGMAP
	help
	  This selects for MediaTek(R) Sub PMIC MT6370 PMU parts.
	  It's cordinate some features like
	  bled, fled, ldo, dsv, charger.
	  Select Y to enable support for MT6370 PMU.

config MT6370_PMU_CHARGER
	tristate "MT6370 PMU Charger Part"
	depends on MFD_MT6370_PMU
	help
	  This selects for MT6370 PMU Charger driver.
	  Usually used in primary charger by gauge and thermal.
	  Depends on MFD_MT6370_PMU.
	  Say Y here to enable support for MT6370 charger device.

config MT6370_PMU_FLED
	tristate "MT6370 PMU FLED Part"
	depends on LEDS_CLASS && MFD_MT6370_PMU
	select FLASHLIGHT
	select RT_FLASH_LED
	help
	  This selects for MT6370 PMU Flashlight LED driver.
	  Support Normal/Strobe/Torch mode by camera.
	  Say Y here to enable support for
	  MT6370 flashlight LED device.

config MT6370_PMU_BLED
	tristate "MT6370 PMU BLED Part"
	depends on LEDS_CLASS && MFD_MT6370_PMU
	help
	  This selects for MT6370 PMU Backlight LED driver.
	  Support use I2C/PWM mode control screen backlight.
	  Say Y here to enable support for
	  MT6370 Backlight LED device.

config MT6370_PMU_RGBLED
	tristate "MT6370 PMU RGBLED Part"
	depends on LEDS_CLASS && MFD_MT6370_PMU
	help
	  Support four channels and cc/pwm/breath mode.
	  Isink4 can also use as CHG_VIN power good Indicator.
	  Say Y here to enable support for
	  MT6370 RGB LED device.

config MT6370_PMU_LDO
	tristate "MT6370 PMU LDO Part"
	depends on REGULATOR && MFD_MT6370_PMU
	help
	  Support Built-In low Dropout Linear Regulator.
	  This selects for Regulator control by IRTX or Vibrator.
	  Operation from Kernel Regulator Framework.
	  Say Y here to enable support for
	  MT6370 ldo device.

config MT6370_PMU_DSV
	tristate "MT6370 PMU DSV Part"
	depends on REGULATOR && MFD_MT6370_PMU
	help
	  This selects for Single High-Efficiency Boost Converter.
	  Provide positive and negative voltage for LCD display bias.
	  Say Y here to enable support for
	  MT6370 dsv device.
```

## src/kernel/mediatek/mt8169/5.4/drivers/misc/mediatek/video/Kconfig
```kconfig
config MTKFB
	tristate "A pseudo framebuffer driver"
	select FB
	select FB_CFB_FILLRECT
	select FB_CFB_COPYAREA
	select FB_CFB_IMAGEBLIT
	---help---
	  This is temporary framebuffer driver to run Android on FPGA to home
	  screen and should be removed after the real driver has been ready.
```

## src/kernel/mediatek/mt8169/5.4/drivers/soc/mediatek/Kconfig
```kconfig
# SPDX-License-Identifier: GPL-2.0-only
#
# MediaTek SoC drivers
#
menu "MediaTek SoC drivers"
	depends on ARCH_MEDIATEK || COMPILE_TEST

config MTK_CMDQ
	tristate "MediaTek CMDQ Support"
	depends on ARCH_MEDIATEK || COMPILE_TEST
	select MAILBOX
	select MTK_CMDQ_MBOX
	help
	  Say yes here to add support for the MediaTek Command Queue (CMDQ)
	  driver. The CMDQ is used to help read/write registers with critical
	  time limitation, such as updating display configuration during the
	  vblank.

config MTK_DEVAPC
	tristate "Mediatek Device APC Support"
	help
	  Say yes here to enable support for Mediatek Device APC driver.
	  This driver is mainly used to handle the violation which catches
	  unexpected transaction.
	  The violation information is logged for further analysis or
	  countermeasures.

config MTK_DVFSRC
	tristate "MediaTek DVFSRC Support"
	depends on ARCH_MEDIATEK
	select PM_GENERIC_DOMAINS if PM
	depends on MTK_SCPSYS
	help
	  Say yes here to add support for the MediaTek DVFSRC (dynamic voltage
	  and frequency scaling resource collector) found
	  on different MediaTek SoCs. The DVFSRC is a proprietary
	  hardware which is used to collect all the requests from
	  system and turn into the decision of minimum Vcore voltage
	  and minimum DRAM frequency to fulfill those requests.


config MTK_PMIC_WRAP
	tristate "MediaTek PMIC Wrapper Support"
	depends on RESET_CONTROLLER
	select REGMAP
	help
	  Say yes here to add support for MediaTek PMIC Wrapper found
	  on different MediaTek SoCs. The PMIC wrapper is a proprietary
	  hardware to connect the PMIC.

config MTK_SCPSYS
	tristate "MediaTek SCPSYS Support"
	default ARCH_MEDIATEK
	select REGMAP
	select PM_GENERIC_DOMAINS if PM
	help
	  Say yes here to add support for the MediaTek SCPSYS power domain
	  driver.

config MTK_MMDVFS
	tristate "MediaTek MMDVFS Support"
	depends on ARCH_MEDIATEK || COMPILE_TEST
	depends on REGULATOR_MTK_DVFSRC
	help
	  Say yes here to add support for the MediaTek Multimedia DVFS (MMDVFS)
	  driver. The MMDVFS is used to set clk for Mediatek multimedia hardwares
	  , such as display, camera, mdp and video codec. Say no if your device
	  does not need to do DVFS for Multimedia hardwares.

config MTK_IPI
	tristate "MediaTek IPI Support"
	depends on RPMSG_MTK
	help
	  Say yes here to add support for the MediaTek IPI between tinysys.
	  MTK IPI consists of APIs to do Linux to/from uP/DSP communication
	  based on rpmsg. Synchronization among tasks is also handled by
	  this layer. If uP/DSP drivers handle by themselves, they can use
	  rpmsg directly.

config MTK_MBOX
	tristate "MediaTek Mbox Support"
	help
	  Say yes here to add support for the MediaTek Mbox driver.
	  MTK MBOX is a physical H/W which consists of configurable 128
	  or 256 bytes SRAM and 32 bit irq. The driver does read/write
	  SRAM and IRQ handling.

config MTK_SCPSYS_PM_DOMAINS
	tristate "MediaTek SCPSYS generic power domain"
	default ARCH_MEDIATEK
	depends on PM && !MTK_SCPSYS_PM_DOMAINS_FPGA
	select PM_GENERIC_DOMAINS
	select REGMAP
	help
	  Say y here to enable power domain support.
	  In order to meet high performance and low power requirements, the System
	  Control Processor System (SCPSYS) has several power management related
	  tasks in the system.

config MTK_SCPSYS_PM_DOMAINS_FPGA
	tristate "MediaTek SCPSYS generic power domain for FPGA"
	depends on PM
	select PM_GENERIC_DOMAINS
	select REGMAP
	help
	  Say y here to enable power domain for fpga support.
	  In order to meet high performance and low power requirements, the System
	  Control Processor System (SCPSYS) has several power management related
	  tasks in the system.

config MTK_SCPSYS_PM_DOMAINS_DISABLE_UNUSED
	tristate "Disable Unused Domain For GKI Project"
	depends on MTK_SCPSYS_PM_DOMAINS
	help
	  Say y here to support disable unused domain for GKI project.
	  Because ko will be inserted after late_init_call,
	  standard disable unused flow is not work. so use reference
	  count in runtime pm to support it.

config MTK_SVS
	tristate "MediaTek Smart Voltage Scaling(SVS)"
	depends on NVMEM
	help
	  The Smart Voltage Scaling(SVS) engine is a piece of hardware
	  which has several controllers(banks) for calculating suitable
	  voltage to different power domains(CPU/GPU/CCI) according to
	  chip process corner, temperatures and other factors. Then DVFS
	  driver could apply SVS bank voltage to PMIC/Buck.

menu "Security"

source "drivers/soc/mediatek/devapc/Kconfig"
source "drivers/soc/mediatek/devmpu/Kconfig"

endmenu # Security

endmenu
```
