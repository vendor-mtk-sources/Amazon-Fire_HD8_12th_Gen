## src/kernel/mediatek/mt8169/5.4/arch/arm64/configs/raspite_defconfig
```kconfig
CONFIG_ARCH_MEDIATEK=y
# CONFIG_ARCH_QCOM is not set
# CONFIG_ARM64_VHE is not set
# CONFIG_PM_DEBUG is not set
CONFIG_SUSPEND_SKIP_SYNC=y
CONFIG_SPECULATIVE_PAGE_FAULT=y
CONFIG_MTK_AAL_SUPPORT=y
CONFIG_MTK_CLK_BUFFER=m
CONFIG_MTK_CLKBUF_BBLPM=y
CONFIG_MTK_CLKBUF_NFC=y
CONFIG_MTK_CM_MGR=m
CONFIG_MTK_CM_MGR_MT8169=m
CONFIG_MTK_DVFSRC_HELPER=m
CONFIG_MTK_DVFSRC_MET=m
CONFIG_MTK_DVFSRC_MET_MT6873=m
CONFIG_MTK_QOS_FRAMEWORK=m
CONFIG_MTK_LOW_POWER_MODULE=m
CONFIG_MTK_LPM_MT8169=m
CONFIG_PMIC_LBAT_SERVICE=m
CONFIG_MFD_MT6370_PMU=m
CONFIG_MT6370_PMU_CHARGER=m
CONFIG_MT6370_PMU_BLED=m
CONFIG_MT6370_PMU_LDO=m
CONFIG_MT6370_PMU_DSV=m
CONFIG_MTK_TINYSYS_SSPM_SUPPORT=m
CONFIG_MTK_TINYSYS_SSPM_V2=y
CONFIG_MTK_IOMMU_MISC=m
CONFIG_MTK_IOMMU_MISC_SEC=m
CONFIG_MTK_CAMERA_ISP_SUPPORT=y
CONFIG_MTK_CAMERA_ISP_PLATFORM="mt8169"
CONFIG_MTK_CAMERA_ISP_RAW_SUPPORT=m
CONFIG_MTK_CAMERA_ISP_MFB_SUPPORT=m
CONFIG_MTK_CAMERA_ISP_DIP_SUPPORT=m
CONFIG_MTK_CAMERA_ISP_RSC_SUPPORT=m
CONFIG_MTK_CAMERA_ISP_WPE_SUPPORT=m
CONFIG_MTK_CMDQ_MBOX_EXT=m
CONFIG_MTK_MDP=m
CONFIG_MTK_SEC_VIDEO_PATH_SUPPORT=y
CONFIG_WFD_DYNAMIC_SEC_BUF=y
CONFIG_MMPROFILE=m
#CONFIG_MTK_LENS is not set
#CONFIG_MTK_V4L2_LENS is not set
CONFIG_MTK_IMGSENSOR=m
CONFIG_CUSTOM_KERNEL_IMGSENSOR="gc02m1_raspite_raw_cxt_rear ov02b10_raspite_raw_cxt_front gc02m1_raspite_raw_jk_rear gc02m1_raspite_raw_jk_front ov02b10_raspite_raw_sjc_rear ov02b10_raspite_raw_sjc_front gc5035_raspite_raw_lce_rear hi556_raspite_raw_hlt_rear sc202cs_raspite_raw_lce_rear"
CONFIG_MTK_IMGSENSOR_MT8169="isp6s"
CONFIG_IMGSENSOR_PROJECT="raspite"
CONFIG_IMGSENSOR_MAIN="gc02m1_raspite_raw_cxt_rear gc02m1_raspite_raw_jk_rear ov02b10_raspite_raw_sjc_rear gc5035_raspite_raw_lce_rear hi556_raspite_raw_hlt_rear sc202cs_raspite_raw_lce_rear"
CONFIG_IMGSENSOR_SUB="ov02b10_raspite_raw_cxt_front gc02m1_raspite_raw_jk_front ov02b10_raspite_raw_sjc_front"
CONFIG_MTK_CAM_CAL=m
CONFIG_MTK_CAM_TIMESYNC=m
CONFIG_MTK_CAMERA_MEM_SUPPORT=m
CONFIG_MTK_VOW_DSP_VERSION="ver01"
CONFIG_MTK_TEE_GP_SUPPORT=m
CONFIG_MTK_TRUSTED_MEMORY_SUBSYSTEM=m
# CONFIG_MTK_ICE_DEBUG is not set
CONFIG_MTK_ATF_LOGGER=m
CONFIG_MTPROF=y
CONFIG_MTK_AEE_FEATURE=m
CONFIG_MTK_AEE_AED=m
CONFIG_MTK_AEE_IPANIC=m
CONFIG_MTK_AEE_HANGDET=m
CONFIG_MTK_AEE_HWT_BACKTO_KERNEL=y
CONFIG_MTK_AEE_SAVE_DEBUGINFO_RESERVED_BUFFER=y
CONFIG_MTK_AEE_SAVE_DEBUGINFO_ADDR=0x4DF10000
CONFIG_MTK_AEE_SAVE_DEBUGINFO_SIZE=0xE1000
CONFIG_MTK_SDA=y
CONFIG_MTK_DBGTOP=m
CONFIG_MTK_BTIF=m
CONFIG_MTK_COMBO=m
CONFIG_MTK_COMBO_CHIP_CONSYS_8169=y
CONFIG_MTK_COMBO_WIFI=y
CONFIG_MTK_FM_CHIP="MT6631_FM"
CONFIG_MTK_CONNSYS_DEDICATED_LOG_PATH=y
CONFIG_TCPC_CLASS=m
CONFIG_TCPC_MT6370=m
CONFIG_EXTCON_MTK_USB=m
CONFIG_ACCDET_OMTP_CTIA_SWITCH_MANUAL=y
CONFIG_MTK_HANG_DETECT=m
CONFIG_MTK_HANG_DETECT_DB=y
CONFIG_USB_CONFIGFS_F_MTP=m
CONFIG_MTK_SENSOR_SUPPORT=m
CONFIG_MTK_SENSOR_ARCHITECTURE="1.0"
CONFIG_CUSTOM_KERNEL_ACCELEROMETER=y
CONFIG_MTK_MC34XX=y
CONFIG_MTK_STK8XXX=y
CONFIG_MTK_SC7A20=y
CONFIG_CUSTOM_KERNEL_ALSPS=y
CONFIG_MTK_LTR559=y
CONFIG_MTK_LTR578=y
CONFIG_MTK_HWMON=y
CONFIG_MTK_SCHEDULER=m
CONFIG_MTK_PERFORMANCE_MODULE=m
CONFIG_MTK_PERFMGR_TOUCH_BOOST=m
CONFIG_MTK_PERF_COMMON=m
CONFIG_MTK_PERF_TRACKER=y
CONFIG_BUILD_CONFIG_FILE="build.config.mtk.aarch64"
CONFIG_MTK_DFD_INTERNAL_DUMP=m
CONFIG_KEYBOARD_MTK_KPD=m
CONFIG_KEYBOARD_MTK_PMIC=m
CONFIG_KPD_VOLUME_KEY_SWAP=y
CONFIG_TOUCHSCREEN_GT9XX=m
CONFIG_TOUCHSCREEN_GOODIX_BRL=m
CONFIG_SERIAL_8250_NR_UARTS=2
CONFIG_SERIAL_8250_RUNTIME_UARTS=2
CONFIG_SERIAL_8250_MT6577=m
CONFIG_I2C_CHARDEV=m
CONFIG_I2C_MT65XX=m
CONFIG_SPI_MT65XX=m
# CONFIG_PINCTRL_MT2712 is not set
# CONFIG_PINCTRL_MT6797 is not set
# CONFIG_PINCTRL_MT7622 is not set
CONFIG_PINCTRL_MT8169=y
# CONFIG_PINCTRL_MT8173 is not set
# CONFIG_PINCTRL_MT8183 is not set
# CONFIG_PINCTRL_MT8516 is not set
# CONFIG_PINCTRL_MT6397 is not set
CONFIG_SYSCON_REBOOT_MODE=m
CONFIG_BATTERY_MT6357=m
CONFIG_MTK_CHARGER_TYPE_DETECT=m
CONFIG_MTK_CHARGER=m
CONFIG_WPC_IDTP922X=m
CONFIG_THERMAL_EMERGENCY_POWEROFF_DELAY_MS=100
CONFIG_VIRTUAL_SENSOR_THERMAL=m
CONFIG_THERMAL_FOD=y
CONFIG_THERMAL_SHUTDOWN_LAST_KMESG=y
CONFIG_THERMAL_DEFAULT_GOV_POWER_ALLOCATOR=y
CONFIG_MTK_THERMAL=m
CONFIG_MTK_SOC_THERMAL_LVTS=m
CONFIG_MTK_PMIC_THERMAL=m
CONFIG_MTK_CHARGER_THERMAL=m
CONFIG_GENERIC_ADC_THERMAL=m
CONFIG_SYSRST_COOLING=m
CONFIG_MEDIATEK_WATCHDOG=m
CONFIG_MFD_MT6397=y
CONFIG_REGULATOR_MA5150=m
CONFIG_REGULATOR_MT6357=y
CONFIG_REGULATOR_MTK_DVFSRC=m
CONFIG_V4L_MEM2MEM_DRIVERS=y
CONFIG_VIDEO_MEDIATEK_JPEG=m
CONFIG_VIDEO_MEDIATEK_HMS=m
CONFIG_VIDEO_MEDIATEK_VCU_WO_FUSE=y
CONFIG_HID_ICADE=y
CONFIG_HID_LENOVO=y
CONFIG_HID_GFRM=y
CONFIG_HID_TIVO=y
CONFIG_HID_ASUS=y
CONFIG_HID_LOGITECH=y
CONFIG_HID_KYE=y
CONFIG_HID_WIIMOTE=y
CONFIG_HID_APPLE=y
CONFIG_HID_SONY=y
CONFIG_HID_ELECOM=y
CONFIG_HID_TOPSEED=y
CONFIG_HID_LOGITECH_HIDPP=y
CONFIG_HID_MICROSOFT=y
CONFIG_HID_NINTENDO=y
CONFIG_HID_MAGICMOUSE=y
CONFIG_VB2_MEDIATEK_DMA_CONTIG=m
CONFIG_VIDEO_MEDIATEK_VCU=m
CONFIG_VIDEO_MEDIATEK_VCODEC=m
CONFIG_VIDEO_MEDIATEK_VCODEC_PLATFORM="mt8169"
CONFIG_DRM_PANEL_ST7705_WXGA_DSI_VDO_RASPITE=m
CONFIG_DRM_PANEL_ILI9881C_WXGA_DSI_VDO_RASPITE=m
CONFIG_DRM_PANEL_ER88577B_WXGA_DSI_VDO_RASPITE=m
CONFIG_DRM_FBDEV_EMULATION=y
CONFIG_DRM_MEDIATEK=m
CONFIG_DRM_MEDIATEK_V2=y
CONFIG_MTK_GPU_SUPPORT=m
CONFIG_MTK_GPU_VERSION="mali bifrost r25p0 mt8169"
CONFIG_MTK_GPU_COMMON_DVFS_SUPPORT=y
CONFIG_SND_SOC_MT8169_RASPITE=m
CONFIG_SND_SOC_MTK_BTCVSD=m
CONFIG_I2C_HID=m
CONFIG_USB_XHCI_HCD=m
CONFIG_USB_MTU3=m
CONFIG_MMC_BLOCK_MINORS=32
CONFIG_MMC_CQHCI=y
CONFIG_MMC_MTK=m
CONFIG_PWM_MEDIATEK=m
CONFIG_LEDS_PWM=m
CONFIG_LEDS_BL_MTK_PWM=m
CONFIG_MTK_LEDS=m
CONFIG_RTC_DRV_MT6397=m
CONFIG_MTK_UART_APDMA=m
CONFIG_MTK_ION_MM_HEAP=m
CONFIG_MTK_ION_SEC_HEAP=m
CONFIG_COMMON_CLK_MEDIATEK_DISABLE_UNUSED=m
CONFIG_MTK_SCPSYS_PM_DOMAINS_DISABLE_UNUSED=m
CONFIG_COMMON_CLK_MT8169=y
CONFIG_COMMON_CLK_MT8169_AUDSYS=y
CONFIG_COMMON_CLK_MT8169_CAMSYS=y
CONFIG_COMMON_CLK_MT8169_IMGSYS=y
CONFIG_COMMON_CLK_MT8169_IMP_IIC_WRAP=y
CONFIG_COMMON_CLK_MT8169_IPESYS=y
CONFIG_COMMON_CLK_MT8169_MDPSYS=y
CONFIG_COMMON_CLK_MT8169_MFGCFG=y
CONFIG_COMMON_CLK_MT8169_MMSYS=y
CONFIG_COMMON_CLK_MT8169_VDECSYS=y
CONFIG_COMMON_CLK_MT8169_VENCSYS=y
CONFIG_COMMON_CLK_MT8169_WPESYS=y
CONFIG_COMMON_CLK_MTK_FREQ_HOPPING=m
CONFIG_CPU_FREQ_GOV_USERSPACE=y
CONFIG_MTK_SCPSYS=y
CONFIG_MTK_SCPSYS_PM_DOMAINS=y
CONFIG_MTK_IOMMU=m
CONFIG_RPMSG_MTK=m
CONFIG_MTK_DVFSRC=m
CONFIG_MTK_PMIC_WRAP=y
CONFIG_MTK_MMDVFS=m
CONFIG_MTK_IPI=m
CONFIG_INTERCONNECT_MTK=m
CONFIG_INTERCONNECT_MTK_EMI=m
CONFIG_INTERCONNECT_MTK_MMQOS_COMMON=m
CONFIG_INTERCONNECT_MTK_MMQOS_MT8169=m
CONFIG_INTERCONNECT_MTK_EXTENSION=m
CONFIG_MTK_MBOX=m
CONFIG_MTK_DEVMPU=m
CONFIG_HAVE_MTK_MC=y
CONFIG_MTK_EMI=m
CONFIG_MTK_EMI_MPU_TEST=m
CONFIG_MTK_DRAMC=m
CONFIG_MEDIATEK_MT635X_AUXADC=m
CONFIG_MEDIATEK_MT6577_AUXADC=m
CONFIG_PWM_MTK_DISP=m
CONFIG_RESET_TI_SYSCON=m
CONFIG_PHY_MTK_TPHY=m
CONFIG_LIBNVDIMM=y
CONFIG_ARM_DSU_PMU=m
CONFIG_MTK_DEVINFO=m
CONFIG_MT635X_EFUSE=m
CONFIG_TEE=m
CONFIG_OPTEE=m
CONFIG_INCREMENTAL_FS=m
CONFIG_STATIC_USERMODEHELPER_PATH="/system_ext/bin/crashreport"
CONFIG_LK_FASTLOGO=y
CONFIG_ARM_MEDIATEK_CPUFREQ=m
CONFIG_ARM_MEDIATEK_CCI_DEVFREQ=m
CONFIG_VIDEO_MTK_AIE=m
CONFIG_MTK_DRAM_LOG_STORE=m
CONFIG_MTK_DRAM_LOG_STORE_ADDR=0x10ff00
CONFIG_MTK_DRAM_LOG_STORE_SIZE=0x100
CONFIG_MTK_SVS=m
CONFIG_IDME=m
CONFIG_SWITCH=m
CONFIG_SND_SOC_DBMDX=m
CONFIG_SND_SOC_DBMDX_SND_CAPTURE=y
CONFIG_SND_SOC_DBMDX_USE_ANALOG_MICS=y
CONFIG_SND_SOC_DBMDX_ALEXA_WWE_SUPPORT=y
CONFIG_AMAZON=y
CONFIG_AMAZON_METRICS_LOG=m
CONFIG_AMAZON_DSP_FRAMEWORK=y
CONFIG_AMAZON_DSP_FRAMEWORK_CHAR_LEN=2
CONFIG_INPUT_HALL_BU520=m
CONFIG_FUSB251=m
CONFIG_MAX20342=m
CONFIG_MTK_PRINTK=m
CONFIG_MTK_MET=m
CONFIG_MTK_MET_PLF="mt8169"
CONFIG_MTK_BOOT=m
CONFIG_SND_SOC_AW87XXX=m
CONFIG_DEBUG_LIST=y
# CONFIG_BUG_ON_DATA_CORRUPTION is not set
# CONFIG_SLUB_DEBUG is not set
# CONFIG_DEBUG_INFO is not set
# CONFIG_DEVMEM is not set
CONFIG_DYNAMIC_DEBUG=y
CONFIG_TRACER_SNAPSHOT=y
CONFIG_TRACER_MAX_TRACE=y
CONFIG_MTK_STATIC_POWER=m
CONFIG_MT8169_STATIC_POWER=m
CONFIG_MTK_DEVAPC=m
CONFIG_RT_REGMAP=m
CONFIG_AMZN_LD=m
CONFIG_PUBADC_MANAGE=m
CONFIG_MDUMP=y
# CONFIG_DEBUG_BUGVERBOSE is not set
CONFIG_USER_BUILD=y
CONFIG_AMAZON_INPUT_KEYCOMBO=m
CONFIG_INPUT_KEYCOMBO=m
CONFIG_AMAZON_POWEROFF_LOG=y
CONFIG_AMAZON_SIGN_OF_LIFE=m
CONFIG_NL80211_TESTMODE=y
# CONFIG_PCI is not set
# CONFIG_PCIEPORTBUS is not set
# CONFIG_PCI_HOST_GENERIC is not set
# CONFIG_PCIE_DW_PLAT_EP is not set
# CONFIG_PCIE_QCOM is not set
# CONFIG_PCIE_KIRIN is not set
# CONFIG_PCI_ENDPOINT is not set
# CONFIG_QCOM_FALKOR_ERRATUM_1003 is not set
# CONFIG_QCOM_FALKOR_ERRATUM_1009 is not set
# CONFIG_QCOM_QDF2400_ERRATUM_0065 is not set
# CONFIG_QCOM_FALKOR_ERRATUM_E1041 is not set
# CONFIG_ARCH_HISI is not set
# CONFIG_ARCH_SUNXI is not set
# CONFIG_ARM64_AMU_EXTN is not set
# CONFIG_ARM64_PTR_AUTH is not set
# CONFIG_ARM64_SSBD is not set
# CONFIG_CAVIUM_ERRATUM_22375 is not set
# CONFIG_CAVIUM_ERRATUM_23154 is not set
# CONFIG_CAVIUM_ERRATUM_27456 is not set
# CONFIG_CAVIUM_ERRATUM_30115 is not set
# CONFIG_CAVIUM_TX2_ERRATUM_219 is not set
# CONFIG_CEC_PLATFORM_DRIVERS is not set
# CONFIG_FUJITSU_ERRATUM_010001 is not set
# CONFIG_HARDEN_BRANCH_PREDICTOR is not set
# CONFIG_HARDEN_EL2_VECTORS is not set
# CONFIG_HISILICON_ERRATUM_161600802 is not set
# CONFIG_KEYBOARD_ATKBD is not set
# CONFIG_POWER_RESET_HISI is not set
# CONFIG_SCSI_UFS_HISI is not set
# CONFIG_SND_SPI is not set
# CONFIG_SOCIONEXT_SYNQUACER_PREITS is not set
# CONFIG_UNMAP_KERNEL_AT_EL0 is not set
# CONFIG_ARM64_ERRATUM_826319 is not set
# CONFIG_ARM64_ERRATUM_827319 is not set
# CONFIG_ARM64_ERRATUM_824069 is not set
# CONFIG_ARM64_ERRATUM_819472 is not set
# CONFIG_ARM64_ERRATUM_832075 is not set
# CONFIG_ARM64_ERRATUM_845719 is not set
# CONFIG_ARM64_ERRATUM_843419 is not set
# CONFIG_ARM64_ERRATUM_1165522 is not set
# CONFIG_ARM64_ERRATUM_1418040 is not set
# CONFIG_ARM64_ERRATUM_1286807 is not set
# CONFIG_ARM64_ERRATUM_1463225 is not set
# CONFIG_ARM64_ERRATUM_1542419 is not set
# CONFIG_FSL_ERRATUM_A008585 is not set
# CONFIG_HISILICON_ERRATUM_161010101 is not set
# CONFIG_ARM64_ERRATUM_858921 is not set
CONFIG_CONNECTOR=y
CONFIG_PROC_EVENTS=y
CONFIG_LOG_BUF_SHIFT=19
CONFIG_POWER_SUPPLY_HWMON=y
CONFIG_HWMON=y
CONFIG_THERMAL_HWMON=y
```

## src/kernel/mediatek/mt8169/5.4/drivers/hid/ILITEK_HID_over_I2c/Kconfig
```kconfig
#
# HID driver configuration
#
config I2C_HID_ILITEK
	tristate "TP ilitek i2c hid enable"
	depends on I2C_HID
	default n
	help
	  say Y to enable driver for Touching Screen using ilitek i2c hid.
	  If unsure, say N.
```

## src/kernel/mediatek/mt8169/5.4/drivers/hid/hid-focal/Kconfig
```kconfig
#
# HID driver configuration
#

config HID_TOUCHSCREEN_FTS
	tristate "TP focaltech i2c hid enable"
	depends on I2C_HID
	default n
	help
	  Say Y to enable driver for Touchpanel using focaltech i2c hid
	  If unsure, say N.
```

## src/kernel/mediatek/mt8169/5.4/drivers/input/touchscreen/gt9xx/Kconfig
```kconfig
#
# Goodix GT9xx Touchscreen driver
#
config TOUCHSCREEN_GT9XX
	tristate "Goodix touchpanel GT9xx series"
	depends on I2C
	default n
	help
	  Say Y here if you have a Goodix GT9xx touchscreen
	  controller.
	  If unsure, say N.

config TOUCHSCREEN_GT9XX_UPDATE
	bool "Goodix GT9xx touch controller auto update support"
	depends on TOUCHSCREEN_GT9XX
	default y
	help
	  Enable this for support firmware update.
	  Say Y here if you want update touch controller firmware.
	  If unsure, say N.

config TOUCHSCREEN_GT9XX_TOOL
	bool "Goodix GT9xx Tools for debugging"
	depends on TOUCHSCREEN_GT9XX
	default y
	help
	  This implement interface support for Goodix GT9xx
	  touchscreen debug.
	  Say Y here if you want to have a Android app debug interface
	  to your system.
	  If unsure, say N.
```

## src/kernel/mediatek/mt8169/5.4/drivers/misc/amazon/Kconfig
```kconfig
#
# Amazon Devices
#

config ACENNA
	tristate "ACENNA"
	default n
	help
	  This option enables support the ACENNA accelerator.
	  If you are not sure, say N here.

config NNA_MT8169
	bool "NNA for MT8169"
	depends on ARCH_MEDIATEK && ACENNA
	help
	  Select this when ACENNA run in MT8169 chip.
	  If you are not sure, say N here.
```

## src/kernel/mediatek/mt8169/5.4/drivers/misc/mediatek/aee/Kconfig
```kconfig
config MTK_AEE_FEATURE
	tristate "Enable Android Exception Enhancement"
	select FIQ_GLUE if !TRUSTONIC_TEE_SUPPORT && !ARM_PSCI && !TRUSTY
	select FTRACE
	help
	  AEE (Android Exception Engine) that designed by  Mediatek is an
	  exception catching and debugging information generation mechanism.
	  It can collect and dump information to filesystem
	  (/sdcard/mtklog/aee_exp)  when exceptions occur(E.g. kernel
	  panic/android system server crash and ..)

config MTK_AEE_AED
	tristate "Enable AEE Kernel Exception Report Daemon"
	depends on MTK_AEE_FEATURE
	help
	  MTK_AEE_AED is the kernel config of aed, which is the base support for
	  aee features. Such as:
	  aed debug: some test case for aee driver itself
	  aed main: aed main function and ioctl for user space aee
	  monitor hang: detect hang feature...

config MTK_AEE_IPANIC
	tristate "Enable AEE Kernel Panic Dump"
	depends on MTK_AEE_FEATURE
	help
	  MTK_AEE_IPANIC is the kernel config of ipanic feature designed by
	  MTK, which is the enhancement of kernel defaut panic flow, and
	  combined with aee. It will do some hook function and get some
	  kernel panic information for debug.

config MTK_AEE_HANGDET
	tristate "Enable AEE Kernel Hang Detector"
	depends on MTK_AEE_FEATURE
	help
	  MTK_AEE_HANGDET is the kernel config of hang detector feature
	  designed by MTK, which is the mechanism to check if each cpu
	  is alived. When cpu hang is detected, raise excetpion.

config MTK_AEE_SAVE_DEBUGINFO_RESERVED_BUFFER
	bool "saving platform debuginfo in console buffer"
	default n
	help
	  If set this config as yes, will save the debuginfo by platform
	  to proc file.

config MTK_AEE_SAVE_DEBUGINFO_ADDR
	hex "MTK KEDUMP SAVE DEBUGINFO dram address"
	default 0
	help
	  DRAM kedump save debuginfo memory address.

config MTK_AEE_SAVE_DEBUGINFO_SIZE
	hex "MTK KEDUMP SAVE DEBUGINFO dram size"
	default 0
	help
	  DRAM kedump save debuginfo allocate size.

config MTK_AEE_HWT_BACKTO_KERNEL
	tristate "AEE HWT flow back to kernel"
	default n
	help
	  MTK_AEE_HWT_BACKTO_KERNEL is the kernel config of designed by
	  MTK, which controls the HWT design:
	  when enable it, then when HWT in atf fiq handler, will call back
	  to kernel to unwind kernel trace.

config MTK_MBOOT_PARAMS_ADDR
	hex "MTK MBOOT_PARAMS dram address"
	default 0
	help
	  DRAM mboot_paras allocate address.

config MTK_MBOOT_PARAMS_SIZE
	hex "MTK MBOOT_PARAMS dram size"
	default 0
	help
	  DRAM mboot_paras allocate size.

config MTK_AEE_UT
	tristate "control AED debug file"
	default n
	help
	  MTK_AEE_UT is the kernel config of aed-debug.c
	  aed-debug.c is AEE UT test case file, just for generate some vendor
	  exception to test AEE dump flow, include in KE, HWT, HW_reboot, EE,
	  and kernelAPI exception
```

## src/kernel/mediatek/mt8169/5.4/drivers/misc/mediatek/dfd/Kconfig
```kconfig
config MTK_DFD_INTERNAL_DUMP
	tristate "Enable MediaTek DFD internal dump"
	help
	  DFD (Design for Debug) is a debugging tool,
	  which scans flip-flops and dumps to internal
	  RAM on the WDT reset. After system reboots,
	  those values could be showed in exception db
	  for debugging.
```

## src/kernel/mediatek/mt8169/5.4/drivers/misc/mediatek/flashlight/richtek/Kconfig
```kconfig
config RT_FLASHLIGHT
	tristate "Richtek Flashlight Device Class"
	help
	  Say Y to enable Richtek Flashlight Device Class
	  This Framework is good for
	  controling flashlight Leds.
	  Say N to disable Richtek Flahslight Device Class
```
